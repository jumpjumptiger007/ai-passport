## main/Kconfig.projbuild
```kconfig
menu "Sonic Link"

config SONIC_DEMO_URL
    string "Demo URL payload"
    default "https://sonic.yliu.tech"
    help
        Canonical production URL preset transmitted by the Send menu. Keep it
        paired with the deployed Sonic Link Web Companion release.

endmenu
```
